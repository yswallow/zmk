## app/boards/arm/isp1807micro/Kconfig.board
```kconfig
# ISP1807Micro board configuration

# Copyright (c) 2021 The ZMK Contributors
# SPDX-License-Identifier: MIT

config BOARD_ISP1807MICRO
	bool "isp1807micro"
	depends on SOC_NRF52840_QIAA
```
